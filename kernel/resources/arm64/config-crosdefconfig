## kernel/resources/arm64/kernel.its
```
/dts-v1/;

/ {
    description = "Linux image for RK3399 Chromebook (gru)";
    images {
        kernel@1{
            description = "kernel";
            data = /incbin/("arch/arm64/boot/Image");
            type = "kernel_noload";
            arch = "arm64";
            os = "linux";
            compression = "none";
            load = <0>;
            entry = <0>;
        };
        fdt@1{
            description = "rk3399-gru-bob.dtb";
            data = /incbin/("arch/arm64/boot/dts/rockchip/rk3399-gru-bob.dtb");
            type = "flat_dt";
            arch = "arm64";
            compression = "none";
            hash@1{
                algo = "sha1";
            };
        };
        fdt@2{
            description = "rk3399-gru-kevin.dtb";
            data = /incbin/("arch/arm64/boot/dts/rockchip/rk3399-gru-kevin.dtb");
            type = "flat_dt";
            arch = "arm64";
            compression = "none";
            hash@1{
                algo = "sha1";
            };
        };
        fdt@3{
            description = "rk3399-gru-scarlet-inx.dtb";
            data = /incbin/("arch/arm64/boot/dts/rockchip/rk3399-gru-scarlet-inx.dtb");
            type = "flat_dt";
            arch = "arm64";
            compression = "none";
            hash@1{
                algo = "sha1";
            };
        };
        fdt4@{
            description = "rk3399-gru-scarlet-kd.dtb";
            data = /incbin/("arch/arm64/boot/dts/rockchip/rk3399-gru-scarlet-kd.dtb");
            type = "flat_dt";
            arch = "arm64";
            compression = "none";
            hash@1{
                algo = "sha1";
            };
        };
    };
    configurations {
        default = "conf@1";
        conf@1{
            kernel = "kernel@1";
            fdt = "fdt@1";
        };
        conf@2{
            kernel = "kernel@1";
            fdt = "fdt@2";
        };
        conf@3{
            kernel = "kernel@1";
            fdt = "fdt@3";
        };
        conf@4{
            kernel = "kernel@1";
            fdt = "fdt@4";
        };
    };
};
```

## kernel/resources/armhf/kernel.its
```
/dts-v1/;

/ {
	description = "Linux-libre kernel image with one or more FDT blobs for armhf";
	#address-cells = <1>;
	images {
		kernel@1 {
			description = "vmlinuz";
			data = /incbin/("arch/arm/boot/zImage");
			type = "kernel_noload";
			arch = "arm";
			os = "linux";
			compression = "none";
			load = <0>;
			entry = <0>;
			hash {
				algo = "sha1";
			};
		};
		fdt@1 {
			description = "dtb";
			data = /incbin/("arch/arm/boot/dts/rk3288-veyron-speedy.dtb");
			type = "flat_dt";
			arch = "arm";
			compression = "none";
			hash {
				algo = "sha1";
			};
		};
		fdt@2 {
			description = "dtb";
			data = /incbin/("arch/arm/boot/dts/rk3288-veyron-minnie.dtb");
			type = "flat_dt";
			arch = "arm";
			compression = "none";
			hash {
				algo = "sha1";
			};
		};
		fdt@3 {
                        description = "dtb";
                        data = /incbin/("arch/arm/boot/dts/rk3288-veyron-mickey.dtb");
                        type = "flat_dt";
                        arch = "arm";
                        compression = "none";
                        hash {
                                algo = "sha1";
                        };
                };

	};
	configurations {
		default = "conf@1";
		conf@1{
			kernel = "kernel@1";
			fdt = "fdt@1";
		};
		conf@2{
			kernel = "kernel@1";
			fdt = "fdt@2";
		};
                conf@3{
                        kernel = "kernel@1";
                        fdt = "fdt@3";
                };

	};
};
```

## resources/BuildResources/kernel.its
```
/dts-v1/;

/ {
	description = "Linux-libre kernel image with one or more FDT blobs";
	#address-cells = <1>;
	images {
		kernel {
			description = "vmlinuz";
			data = /incbin/("arch/arm/boot/zImage");
			type = "kernel_noload";
			arch = "arm";
			os = "linux";
			compression = "none";
			load = <0>;
			entry = <0>;
			hash {
				algo = "sha1";
			};
		};
		fdt {
			description = "dtb";
			data = /incbin/("arch/arm/boot/dts/rk3288-veyron-speedy.dtb");
			type = "flat_dt";
			arch = "arm";
			compression = "none";
			hash {
				algo = "sha1";
			};
		};
	};
	configurations {
		default = "conf";
		conf{
			kernel = "kernel";
			fdt = "fdt";
		};
	};
};
```
